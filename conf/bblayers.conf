## conf/bblayers.conf
```bitbake
# POKY_BBLAYERS_CONF_VERSION is increased each time build/conf/bblayers.conf
# changes incompatibly
POKY_BBLAYERS_CONF_VERSION = "2"

BBPATH = "${TOPDIR}"
BBFILES ?= ""

BBLAYERS ?= " \
  /home/ac/poky/meta \
  /home/ac/poky/meta-poky \
  /home/ac/poky/meta-yocto-bsp \
  /home/ac/build-helloworld-recipe/meta-helloworld-app \
  "
```

## meta-helloworld-app/conf/layer.conf
```bitbake
# We have a conf and classes directory, add to BBPATH
BBPATH .= ":${LAYERDIR}"

# We have recipes-* directories, add to BBFILES
BBFILES += "${LAYERDIR}/recipes-*/*/*.bb \
            ${LAYERDIR}/recipes-*/*/*.bbappend"

BBFILE_COLLECTIONS += "meta-hellooworld-app"
BBFILE_PATTERN_meta-hellooworld-app = "^${LAYERDIR}/"
BBFILE_PRIORITY_meta-hellooworld-app = "6"

LAYERDEPENDS_meta-hellooworld-app = "core"
LAYERSERIES_COMPAT_meta-hellooworld-app = "nanbield"
```
